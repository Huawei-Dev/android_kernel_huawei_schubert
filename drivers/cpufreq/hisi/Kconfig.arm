## drivers/cpufreq/hisi/Kconfig.arm
```kconfig
config HISI_ENABLE_HPM_DATA_COLLECT
	bool "Hisilicon get hpm volt param"
	depends on HISI_ENABLE_GET_VAL
	default n
	help
	  Hisilicon get avs hpm volt param.

config HISI_CPUFREQ_DT
	bool "Hisilicon cpufreq-dt enable"
	depends on CPUFREQ_DT
	default n
	help
	  Hisilicon cpufreq-dt enable.

config CPU_FREQ_POWER_STAT
	bool "Estimation of task power consumption"
	depends on CPU_FREQ_STAT
	select CPU_FREQ_TIMES
	default n
	help
	  Keep track of amount of power each task consumes and report power per uid

config HISI_CPU_FREQ_GOV_SCHEDUTIL
	bool "Hisilicon 'schedutil' cpufreq governor optimize"
	depends on CPU_FREQ_GOV_SCHEDUTIL
	default n
	help
	  This extends the functionality of existing schedutil governor.

config HISI_CPU_FREQ_LOCK_DETECT
	bool "Hisilicon schedutil detect freq lock&unlock"
	depends on HISI_CPU_FREQ_GOV_SCHEDUTIL
	default n
	help
	  This extends min_sample_time when boost scene finish
```

## security/kernel_harden/Kconfig
```kconfig
#
# Huawei Kernel Harden
#

menu "Huawei Kernel Harden"

config HUAWEI_KERNEL_STACK_RANDOMIZE
    bool "stack randomize"
    depends on ARM64 && !KASAN
    default n
    help
    Randomizes the base address of process's kernel stack.

config HUAWEI_KERNEL_STACK_RANDOMIZE_STRONG
    bool "stack randomize strong"
    depends on ARM64 && !KASAN
    default n
    help
    Randomizes the base address of process's thread_info struct.

config HUAWEI_HIDESYMS
	bool "hide symbols"
	default n
	help
	Hide some sensitive kernel symbols
endmenu
#a blank line must be existed
```
